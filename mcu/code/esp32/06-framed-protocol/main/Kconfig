## mcu/code/esp32/06-framed-protocol/main/Kconfig
```kconfig
menu "Reliability protocol test faults"

    config RELIABILITY_TEST_FAULTS
        bool "Enable TEST_FAULT command (test builds only)"
        default n
        help
            Enables the TEST_FAULT (0x7F) request handler so the host CLI can
            inject a bounded fault: 1 = uart task stops servicing (simulated
            hang), 2 = TX stepping pauses while RX parsing continues.
            Keep disabled in normal builds: normal builds answer UNSUPPORTED
            and never fault on their own.

endmenu
```

## mcu/code/esp32/07-watchdog-health/main/Kconfig.projbuild
```kconfig
menu "Reliability teaching"
config RELIABILITY_TEST_FAULTS
    bool "Allow explicit TEST_FAULT requests"
    default n
endmenu
```

## mcu/code/esp32/08-sensor-logger/main/Kconfig.projbuild
```kconfig
menu "Logger teaching tests"
config RELIABILITY_TEST_FAULTS
 bool "Allow explicit fault commands"
 default n
endmenu
```

## mcu/code/esp32/08-sensor-logger/sdkconfig.defaults
```kconfig
CONFIG_IDF_TARGET="esp32s3"
CONFIG_ESPTOOLPY_FLASHSIZE_16MB=y
CONFIG_ESP_SYSTEM_PANIC_PRINT_REBOOT=y
```
